/* SpaceHack Cap Badge - York Hackspace June 2014
 * A sketch for Adafruit Gemma combining a neopixel ring with an 8x8 matrix
 * We used this as an animated cap badge on a military beret, when presenting
 * the SpaceHack game at events.  The animated cap badge and military beret
 * hypnotise visitors into agreeing to participate with the game.
 * Wire D1 to the NeoPixel ring's data input, and D0/D2 to the 8x8's D and C.
 */

#define BRIGHTNESS   12 // 0=min, 15=max
#define I2C_ADDR   0x70 // Edit if backpack A0/A1 jumpers set

#include <TinyWireM.h>
#include <avr/power.h>
#include <avr/sleep.h>
#include "anim.h"       // Animation data is located here

#include <Adafruit_NeoPixel.h>
 
#define PIN 1
Adafruit_NeoPixel pixels = Adafruit_NeoPixel(16, PIN);
uint8_t  offset = 0; // Position of spinny eyes
uint32_t red  = 0xff0000;
uint32_t green  = 0x00ff00;
uint32_t blue  = 0x0000ff;
uint32_t yellow  = 0xffff00;
unsigned long lastCapTick=0, lastFrameTick=0;
int frameDelay=0, capDelay=0, frame=0;

static const uint8_t PROGMEM reorder[] = { // Column-reordering table
    0x00,0x40,0x20,0x60,0x10,0x50,0x30,0x70,0x08,0x48,0x28,0x68,0x18,0x58,0x38,0x78,
    0x04,0x44,0x24,0x64,0x14,0x54,0x34,0x74,0x0c,0x4c,0x2c,0x6c,0x1c,0x5c,0x3c,0x7c,
    0x02,0x42,0x22,0x62,0x12,0x52,0x32,0x72,0x0a,0x4a,0x2a,0x6a,0x1a,0x5a,0x3a,0x7a,
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    0x87,0xc7,0xa7,0xe7,0x97,0xd7,0xb7,0xf7,0x8f,0xcf,0xaf,0xef,0x9f,0xdf,0xbf,0xff };

void ledCmd(uint8_t x) { // Issue command to LED backback driver
  TinyWireM.beginTransmission(I2C_ADDR);
  TinyWireM.write(x);
  TinyWireM.endTransmission();
}

void clear(void) { // Clear display buffer
  TinyWireM.beginTransmission(I2C_ADDR);
  for(uint8_t i=0; i<17; i++) TinyWireM.write(0);
  TinyWireM.endTransmission();
}

bool cycleCheck(unsigned long *lastMillis, unsigned int cycle)
{
  unsigned long currentMillis = millis();
  if(currentMillis - *lastMillis >= cycle)
  {
    *lastMillis = currentMillis;
    return true;
  }
  else
    return false;
} 

void setup() {
  power_timer1_disable();    // Disable unused peripherals
  power_adc_disable();       // to save power
  TinyWireM.begin();         // I2C init
  clear();                   // Blank display
  ledCmd(0x21);              // Turn on oscillator
  ledCmd(0xE0 | BRIGHTNESS); // Set brightness
  ledCmd(0x81);              // Display on, no blink
  
  pixels.begin();
  pixels.setBrightness(30); // 1/3 brightness
  capDelay = 70;
  frameDelay = 0;
}

uint8_t rep = REPS;

void loop() {
  if (cycleCheck(&lastCapTick, capDelay)) {
    uint8_t  i;
    uint32_t t;
    for(i=0; i<16; i++) {
      uint32_t c = 0;
      if(((offset + i) & 15) == 1) c = red; 
      if(((offset + i + 4) & 15) == 1) c = green; 
      if(((offset + i + 8) & 15) == 1) c = blue;
      if(((offset + i + 12) & 15) == 1) c = yellow;
      pixels.setPixelColor(   i, c); // First eye
    }
    pixels.show();
    offset++;
  }
  if (cycleCheck(&lastFrameTick, frameDelay)) {
    TinyWireM.beginTransmission(I2C_ADDR);
    TinyWireM.write(0);             // Start address
    for(uint8_t j=0; j<8; j++) {    // 8 rows...
      TinyWireM.write(pgm_read_byte(&reorder[pgm_read_byte(&anim[frame++])]));
      TinyWireM.write(0);
    }
    TinyWireM.endTransmission();
    frameDelay = pgm_read_byte(&anim[frame++]) * 10;
    if (frame == sizeof(anim))
      frame = 0;
  }

}
